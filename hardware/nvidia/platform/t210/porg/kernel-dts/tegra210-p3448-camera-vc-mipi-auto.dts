// SPDX-License-Identifier: GPL-2.0
/dts-v1/;
/plugin/;

#define VC_OVERLAY_NAME "Camera VC MIPI (Custom) / Auto Detect"
#define VC_PROFILE_MODEL "Auto Detect"
#define VC_CAMERA_BADGE "porg_front_vc_mipi_auto"
#define VC_NUM_LANES 2
#define VC_NUM_LANES_STRING "2"
#define VC_PHYSICAL_W "1.000"
#define VC_PHYSICAL_H "1.000"
#define VC_ACTIVE_W "0"
#define VC_ACTIVE_H "0"
#define VC_MAX_GAIN "48000"
#define VC_STEP_GAIN "100"
#define VC_MAX_FRAMERATE "60000"

#include "tegra210-p3448-camera-vc-mipi-profile.dtsi"
