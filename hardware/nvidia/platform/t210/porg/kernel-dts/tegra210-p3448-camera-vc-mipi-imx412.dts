// SPDX-License-Identifier: GPL-2.0
/dts-v1/;
/plugin/;

#define VC_OVERLAY_NAME "Camera VC MIPI (Custom) / IMX412"
#define VC_PROFILE_MODEL "IMX412"
#define VC_CAMERA_BADGE "porg_front_vc_mipi_imx412"
#define VC_FORCE_MOD_ID 0x0412
#define VC_NUM_LANES 2
#define VC_NUM_LANES_STRING "2"
#define VC_PHYSICAL_W "6.250"
#define VC_PHYSICAL_H "4.712"
#define VC_ACTIVE_W "4032"
#define VC_ACTIVE_H "3040"
#define VC_MAX_GAIN "51000"
#define VC_STEP_GAIN "50"
#define VC_MAX_FRAMERATE "20000"

#include "tegra210-p3448-camera-vc-mipi-profile.dtsi"
